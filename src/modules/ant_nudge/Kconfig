## src/modules/ant_nudge/Kconfig
```kconfig
menuconfig MODULES_ANT_NUDGE
	bool "ant_nudge"
	default n
	---help---
		Enable support for ant_nudge
```

## src/modules/ant_pulse/Kconfig
```kconfig
menuconfig MODULES_ANT_PULSE
	bool "ant_pulse"
	default n
	---help---
		Enable support for ant_pulse
```
